/* ---------------------------------------------------------------------
 * 
 * board解析库函数:
 * 硬件初始化
 *
 *   修订操作      版本号       日期         修订人
 * ------------    ------    ----------    ------------
 *     创建        1.0       2018.01.19      Universea
 *
 * ---------------------------------------------------------------------*/
#include "board.h"
#include "W25Qxx.h"
#include "FreeRTOS.h"
#include "task.h"
#include "tim.h"
#include "LedColors.h"
/**********************************************************************************************************
*函 数 名: boardInit
*功能说明: 飞控硬件初始化
*形    参: 无
*返 回 值: 无
**********************************************************************************************************/
void boardInit(void)
{
		flashInit();
		RGB_Init();
		PWM_Out_Init();
}

/**********************************************************************************************************
*函 数 名: softDelayMs
*功能说明: 毫秒级软件延时，基于STM32F4 168M主频的调试值，不同单片机有所区别
*形    参: 延时时间
*返 回 值: 无
**********************************************************************************************************/
void softDelayMs(uint32_t ms)
{
    uint32_t us_cnt;
    for(; ms!= 0; ms--)
    {
        us_cnt = 42000;
        while(us_cnt)
        {
            us_cnt--;
        }
    }
}

/**********************************************************************************************************
*函 数 名: softDelayUs
*功能说明: 微秒级软件延时，基于STM32F4 168M主频的调试值，不同单片机有所区别
*形    参: 延时时间
*返 回 值: 无
**********************************************************************************************************/
void softDelayUs(uint32_t us)
{
    uint32_t us_cnt;
    for(; us!= 0; us--)
    {
        us_cnt = 35;
        while(us_cnt)
        {
            us_cnt--;
        }
    }
}

/**********************************************************************************************************
*函 数 名: osDelayMs
*功能说明: 系统休眠延时
*形    参: 延时时间
*返 回 值: 无
**********************************************************************************************************/
void osDelayMs(uint32_t ms)
{
    vTaskDelay(ms);
}

/**********************************************************************************************************
*函 数 名: getSysTimeUs
*功能说明: 获取当前系统运行时间，单位为微秒
*形    参: 无
*返 回 值: 系统时间
**********************************************************************************************************/
uint64_t getSysTimeUs(void)
{
    uint64_t ms;
    uint64_t value;
    ms = xTaskGetTickCount();
    value = ms * 1000 + (SysTick->LOAD - SysTick->VAL) * 1000 / SysTick->LOAD;
    return value;
}

/**********************************************************************************************************
*函 数 名: getSysTimeMs
*功能说明: 获取当前系统运行时间，单位为毫秒
*形    参: 无
*返 回 值: 系统时间
**********************************************************************************************************/
uint32_t getSysTimeMs(void)
{
    return xTaskGetTickCount();
}


